## firmware/main/Kconfig.projbuild
```kconfig
menu "Application Configuration"
config APP_WIFI_STA_SSID
    string "WiFi station SSID"
    default "stationssid"
    help
	SSID (network name) for the application to connect to.

config APP_WIFI_STA_PASS
    string "WiFi Password"
    default "stationpassword"
    help
	WiFi password (WPA or WPA2) for the application to use.
	
config APP_WIFI_AP_SSID
    string "WiFi Soft-AP SSID"
    default "serverssid"
    help
	SSID (network name) for the Soft-AP.
	
config APP_WIFI_AP_MAX_CONN
	int "Max number of clients"
	default 3
	help
	Max number of clients connected to AP at the same time.
	
config APP_MQTT_HOST
    string "MQTT host"
    default "localhost"
    help
	MQTT broker, must be an IPv4 address.
	
config APP_MQTT_PORT
    int "MQTT port"
    default 1883
    help
	MQTT port number.
	
config APP_MQTT_INPUT_TOPIC
    string "MQTT input topic"
    default "data/app"
    help
	MQTT data input topic.
	
config APP_MQTT_OUTPUT_TOPIC
    string "MQTT input topic"
    default "data/node"
    help
	MQTT data output topic.
endmenu
```

## sdkconfig.defaults
```kconfig
#
# Serial flasher config
#
CONFIG_ESPTOOLPY_FLASHSIZE_4MB=y
# end of Serial flasher config

#
# Partition Table
#
CONFIG_PARTITION_TABLE_CUSTOM=y
CONFIG_PARTITION_TABLE_CUSTOM_FILENAME="partitions.csv"
CONFIG_PARTITION_TABLE_FILENAME="partitions.csv"
# end of Partition Table

#
# ESP32S2-specific
#
CONFIG_ESP32S2_DEFAULT_CPU_FREQ_240=y
CONFIG_ESP32S2_DEFAULT_CPU_FREQ_MHZ=240
# end of ESP32S2-specific

#
# FreeRTOS
#
CONFIG_FREERTOS_HZ=1000
# end of FreeRTOS

#
# Application Configuration
#
CONFIG_APP_WIFI_STA_SSID="test"
CONFIG_APP_WIFI_STA_PASS="orcobebe"
CONFIG_APP_WIFI_AP_SSID="file_server"
CONFIG_APP_WIFI_AP_MAX_CONN=3
CONFIG_APP_MQTT_HOST="192.168.1.127"
CONFIG_APP_MQTT_PORT=1883
CONFIG_APP_MQTT_INPUT_TOPIC="data/app"
CONFIG_APP_MQTT_OUTPUT_TOPIC="data/node"
# end of Application Configuration
```
